## components/lamp/Kconfig.projbuild
```kconfig
menu "Lamp control"

    config CH1_RELAY
        int "Lamp1 control GPIO"
        range 0 34
        default 13
        help
            GPIO number (IOxx) to control RELAY 1.

    config CH2_RELAY
        int "Lamp2 control GPIO"
        range 0 34
        default 27
        help
            GPIO number (IOxx) to control RELAY 2.

    config INDICATOR_PIN
        int "Blue led flashing pin"
        range 0 34
        default 2
        help
            Set to 0 to disable blue led

    config MANUAL_CONTROL_PIN
        int "Control flip/flip connection pin"
        range 0 34
        default 15
        help
            Set to 0 to disable manual control


endmenu
```

## components/power-sensor/Kconfig.projbuild
```kconfig
menu "Power sensor"

    config POWER_PIN
        int "Power sensor pin"
        range 0 34
        default 14
        help
            Power sensor optron output

endmenu
```

## main/Kconfig.projbuild
```kconfig
menu "Operation mode"

	choice OPERATION_MODE
		prompt "Operation mode"
		help
			Select opration mode : 
				Kitchen mode : 2-Lamps are used, select 1/2/both lamps with power switch/WIFI
				Garage mode : 1-Lamp is controlled with dedicated flip-flop switch
		config KITCHEN_MODE
			bool "Kitchen mode"

		config GARAGE_MODE
			bool "Garage mode"

	endchoice 

	menu "Garage mode"
		visible if GARAGE_MODE
		choice GARAGE_MODE_SETUP
			prompt "Garage mode setup"
			help 
				Select lamp controlled in GARAGE mode 
			config GARAGE_LAMP1
				bool "Use LAMP 1"

			config GARAGE_LAMP2
				bool "Use LAMP 2"

			config GARAGE_BOTH_LAMPS
				bool "Use both lamps"
		endchoice
		choice GARAGE_BLUETOOTH
			prompt "Bluetooth enabled"
			help 
				Select to enable bluetooth activation
			config GARAGE_BT_ON
				bool "YES"
			config GARAGE_BT_OFF
				bool "OFF"
		endchoice
	endmenu

endmenu

menu "WIFI"

    config ESP_WIFI_SSID
        string "WiFi SSID"
        default "myssid"
        help
            SSID (network name) for the example to connect to.

    config ESP_WIFI_PASSWORD
        string "esp32"
        default "123qweasd"
        help
            WiFi password (WPA or WPA2) for the example to use.

    config ESP_MAX_STA_CONN
        int "Maximal STA connections"
        default 4
        help
            Max number of the STA connects to AP.

endmenu
```
